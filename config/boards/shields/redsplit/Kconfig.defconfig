## config/boards/shields/redsplit/Kconfig.defconfig
```kconfig
if SHIELD_REDSPLIT_LEFT
  config ZMK_KEYBOARD_NAME
    default "redsplit"

  config ZMK_SPLIT_ROLE_CENTRAL
    default y
endif


if SHIELD_REDSPLIT_RIGHT
  config I2C
    default y
endif


if SHIELD_REDSPLIT_LEFT || SHIELD_REDSPLIT_RIGHT
  CONFIG_MAIN_STACK_SIZE=4096
  CONFIG_INPUT_THREAD_STACK_SIZE=4096
  config ZMK_SPLIT
      default y

  config ZMK_POINTING
    default y

endif
```

## config/boards/shields/redsplit/Kconfig.shield
```kconfig
# No whitespace after the comma or in your part name!
config SHIELD_REDSPLIT_LEFT
  def_bool $(shields_list_contains,redsplit_left)

# No whitespace after the comma or in your part name!
config SHIELD_REDSPLIT_RIGHT
  def_bool $(shields_list_contains,redsplit_right)
```

## config/west.yml
```yaml
manifest:
  remotes:
    - name: zmkfirmware
      url-base: https://github.com/zmkfirmware
    - name: halfdane
      url-base: https://github.com/halfdane
  projects:
    - name: zmk
      remote: zmkfirmware
      revision: 118359c83efa0758144489fd5e12cc6f5bdbad4c # main
      import: app/west.yml
    - name: zephyr
      remote: zmkfirmware
      revision: 75c39cc7d8df64a6a29db5b7ca791bfbdfb016cf # v4.1.0+zmk-fixes
      import:
        name-blocklist:
          - ci-tools
          - hal_altera
          - hal_cypress
          - hal_infineon
          - hal_microchip
          - hal_nxp
          - hal_openisa
          - hal_silabs
          - hal_xtensa
          - hal_st
          - hal_ti
          - loramac-node
          - mcuboot
          - mcumgr
          - net-tools
          - openthread
          - edtt
          - trusted-firmware-m
    - name: zmk-input-gestures
      remote: halfdane
      revision: main
    - name: zmk-input-processors
      remote: halfdane
      revision: main
    # - name: cirque-input-module
    #   remote: halfdane
    #   revision: absolute_mode
  self:
    path: config
```
