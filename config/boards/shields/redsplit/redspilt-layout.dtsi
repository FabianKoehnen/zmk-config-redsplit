#include <physical_layouts.dtsi>

/ {
  physical_layout0: physical_layout_0 {
      kscan = <&default_kscan>;
      transform = <&default_transform>;
      compatible = "zmk,physical-layout";
      display-name = "Redsplit Keyboard";
  };
};
